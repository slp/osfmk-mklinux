## mklinux/src/arch/osfmach3_ppc/config.in
```kconfig
# Copyright 1991-1998 by Open Software Foundation, Inc. 
#              All Rights Reserved 
#  
# Permission to use, copy, modify, and distribute this software and 
# its documentation for any purpose and without fee is hereby granted, 
# provided that the above copyright notice appears in all copies and 
# that both the copyright notice and this permission notice appear in 
# supporting documentation. 
#  
# OSF DISCLAIMS ALL WARRANTIES WITH REGARD TO THIS SOFTWARE 
# INCLUDING ALL IMPLIED WARRANTIES OF MERCHANTABILITY AND FITNESS 
# FOR A PARTICULAR PURPOSE. 
#  
# IN NO EVENT SHALL OSF BE LIABLE FOR ANY SPECIAL, INDIRECT, OR 
# CONSEQUENTIAL DAMAGES OR ANY DAMAGES WHATSOEVER RESULTING FROM 
# LOSS OF USE, DATA OR PROFITS, WHETHER IN ACTION OF CONTRACT, 
# NEGLIGENCE, OR OTHER TORTIOUS ACTION, ARISING OUT OF OR IN CONNECTION 
# WITH THE USE OR PERFORMANCE OF THIS SOFTWARE. 
# 
# 
# MkLinux
#

#
# For a description of the syntax of this configuration file,
# see the Configure script.
#
mainmenu_name "Linux Kernel Configuration"

mainmenu_option next_comment
comment 'OSF/Mach3 Linux Server options'
define_bool CONFIG_OSFMACH3 y
bool 'OSF/Mach3 Server debugging assertions' CONFIG_OSFMACH3_DEBUG
int 'VM discard back-off timer (seconds)' CONFIG_OSFMACH3_VM_TIMER_BACKOFF 2
int 'VM buffer cache withdraw size' CONFIG_OSFMACH3_VM_BUFFER_CACHE_WITHDRAW_SIZE 20
endmenu

mainmenu_option next_comment
comment 'Code maturity level options'
bool 'Prompt for development and/or incomplete code/drivers' CONFIG_EXPERIMENTAL
endmenu

define_bool CONFIG_PMAC_CONSOLE y
define_bool CONFIG_PMAC_KEYBOARD y

mainmenu_option next_comment
comment 'Loadable module support'
bool 'Enable loadable module support' CONFIG_MODULES
if [ "$CONFIG_MODULES" = "y" ]; then
  bool 'Set version information on all symbols for modules' CONFIG_MODVERSIONS
  bool 'Kernel daemon support (e.g. autoload of modules)' CONFIG_KERNELD
fi
endmenu

mainmenu_option next_comment
comment 'General setup'

#bool 'Kernel math emulation' CONFIG_MATH_EMULATION
bool 'Networking support' CONFIG_NET
#bool 'Limit memory to low 16MB' CONFIG_MAX_16M
#bool 'PCI bios support' CONFIG_PCI
#if [ "$CONFIG_PCI" = "y" ]; then
#  if [ "$CONFIG_EXPERIMENTAL" = "y" ]; then
#    bool '   PCI bridge optimization (experimental)' CONFIG_PCI_OPTIMIZE
#  fi
#fi
bool 'System V IPC' CONFIG_SYSVIPC
tristate 'Kernel support for a.out binaries' CONFIG_BINFMT_AOUT
tristate 'Kernel support for ELF binaries' CONFIG_BINFMT_ELF
tristate 'Kernel support for JAVA binaries' CONFIG_BINFMT_JAVA
bool 'Compile kernel as ELF - if your GCC is ELF-GCC' CONFIG_KERNEL_ELF
endmenu

source osfmach3/blk_dev/Config.in

if [ "$CONFIG_NET" = "y" ]; then
  source net/Config.in
fi

mainmenu_option next_comment
comment 'SCSI support'

#tristate 'SCSI support' CONFIG_SCSI

#if [ "$CONFIG_SCSI" != "n" ]; then
#  source drivers/scsi/Config.in
#fi
#endmenu

if [ "$CONFIG_NET" = "y" ]; then
  mainmenu_option next_comment
  comment 'Network device support'

  bool 'Network device support' CONFIG_NETDEVICES
  if [ "$CONFIG_NETDEVICES" = "y" ]; then
    source osfmach3/net_dev/Config.in
  fi
  endmenu
fi

#mainmenu_option next_comment
#comment 'ISDN subsystem'

#tristate 'ISDN support' CONFIG_ISDN
#if [ "$CONFIG_ISDN" != "n" ]; then
#  source drivers/isdn/Config.in
#fi
#endmenu

#mainmenu_option next_comment
#comment 'CD-ROM drivers (not for SCSI or IDE/ATAPI drives)'

#bool 'Support non-SCSI/IDE/ATAPI CDROM drives' CONFIG_CD_NO_IDESCSI
#if [ "$CONFIG_CD_NO_IDESCSI" != "n" ]; then
#  source drivers/cdrom/Config.in
#fi
#endmenu

source fs/Config.in

source osfmach3/chr_dev/Config.in

mainmenu_option next_comment
comment 'Sound'

tristate 'Sound card support' CONFIG_SOUND
#if [ "$CONFIG_SOUND" != "n" ]; then
#  source drivers/sound/Config.in
#fi
endmenu

mainmenu_option next_comment
comment 'Kernel hacking'

#bool 'Debug kmalloc/kfree' CONFIG_DEBUG_MALLOC
#bool 'Kernel profiling support' CONFIG_PROFILE
#if [ "$CONFIG_PROFILE" = "y" ]; then
#  int ' Profile shift count' CONFIG_PROFILE_SHIFT 2
#fi
endmenu
```
